## CMakeLists.txt
```
cmake_minimum_required(VERSION 3.20.0)

find_package(Zephyr REQUIRED HINTS $ENV{ZEPHYR_BASE})
project(zephyr_CellCom_app)

target_sources(app PRIVATE
    src/client_id.c
    src/ESP32_temperature.c
    src/main.c
    src/mqtt_client.c
    src/mqtt_payload.c
    src/wifi_network.c
)
```

## prj.conf
```kconfig
CONFIG_NETWORKING=y
CONFIG_WIFI=y
CONFIG_NET_LOG=y
CONFIG_LOG=y
CONFIG_PRINTK=y
CONFIG_SENSOR=y
CONFIG_ESPTOOLPY_FLASHSIZE_4MB=y

CONFIG_NET_TCP=y
CONFIG_NET_IPV4=y
CONFIG_NET_DHCPV4=y

CONFIG_MQTT_LIB=y
CONFIG_NET_SOCKETS=y
CONFIG_POLL=y

CONFIG_ENTROPY_GENERATOR=y

# Sparkplug B payloads (protobuf, via nanopb module)
CONFIG_NANOPB=y

# SNTP for real UTC timestamps in Sparkplug payloads
CONFIG_SNTP=y
CONFIG_NET_UDP=y
CONFIG_DNS_RESOLVER=y

# Main thread does the sampling loop
CONFIG_MAIN_STACK_SIZE=2048
```

## boards/esp32c6_devkitc_esp32c6_hpcore.overlay
```dts
/ {
    chosen {
        zephyr,console = &usb_serial;
        zephyr,shell-uart = &usb_serial;
    };
};

&usb_serial {
    status = "okay";
};

&coretemp {
    status = "okay";
    range-min = <(-10)>;
    range-max = <80>;
};
```

## src/main.c
```c
#include <zephyr/kernel.h>
#include <zephyr/logging/log.h>

#include "app_config.h"
#include "client_id.h"
#include "wifi_network.h"
#include "mqtt_client.h"
#include "time_sync.h"
#include "ESP32_temperature.h"

LOG_MODULE_REGISTER(app, LOG_LEVEL_INF);

int main(void)
{
    LOG_INF("Zephyr app started");

    build_client_id_initialize();
    LOG_INF("client id: %s", build_client_id_get());

    if (network_initialize() != 0) {
        LOG_ERR("network init failed");
    }

    /* Real UTC timestamps for Sparkplug. If this fails, the MQTT thread
     * retries before each session. */
    time_sync_initialize();

    mqtt_client_initialize();

    if (ESP32_temperature_initialize() != 0) {
        LOG_ERR("no temperature sensor, nothing to sample");
        return 0;
    }

    /* Application thread: sample on a fixed interval and queue the result.
     * The MQTT thread batches and publishes, so a slow or broken network
     * never shifts the sampling interval. */
    int64_t next = k_uptime_get();

    while (1) {
        /* Stamped with uptime; converted to UTC when it is sent */
        struct sparkplug_sample s = { .timestamp_ms = (uint64_t)k_uptime_get() };

        if (ESP32_temperature_read(&s.temperature_c) == 0) {
            mqtt_client_queue_sample(&s);
            LOG_DBG("sample %d mC", (int)(s.temperature_c * 1000));
        }

        next += APP_SAMPLE_INTERVAL_S * MSEC_PER_SEC;
        k_sleep(K_TIMEOUT_ABS_MS(next));
    }

    return 0;
}
```

## src/ESP32_temperature.c
```c
#include <zephyr/kernel.h>
#include <zephyr/device.h>
#include <zephyr/drivers/sensor.h>

#include <zephyr/kernel.h>
#include <zephyr/device.h>
#include <zephyr/drivers/sensor.h>
#include <zephyr/sys/printk.h>
#include "ESP32_temperature.h"

int ESP32_temperature_initialize(void){
    const struct device *temperature_sensor =
        DEVICE_DT_GET(DT_ALIAS(die_temp0));
    struct sensor_value temperature;

    if (!device_is_ready(temperature_sensor)) {
        printk("Internal temperature sensor is not ready\n");
        return 0;
    }

    while (1) {
        if (sensor_sample_fetch(temperature_sensor) == 0 &&
            sensor_channel_get(temperature_sensor, SENSOR_CHAN_DIE_TEMP,
                               &temperature) == 0) {
            printk("Internal temperature: %d.%02d C\n",
                temperature.val1, temperature.val2 / 10000);
        } else {
            printk("Failed to read internal temperature\n");
        }

        k_sleep(K_SECONDS(15));
    }
}
```

## src/ESP32_temperature.h
```c
// pragma once ensures that the header file is only included once
#pragma once

/* Checks that the internal die temperature sensor is ready. 0 = ok. */
int ESP32_temperature_initialize(void);

/* One reading in degrees C. 0 = ok, negative errno on failure. */
int ESP32_temperature_read(float *celsius);
```

## src/app_config.h
```c
/* app_config.h - tunables for sampling, batching and Sparkplug naming.
 *
 * Everything that changes the data/power trade-off lives here, so it can be
 * tuned in one place (and argued for in the report).
 */
#pragma once

/* Sparkplug B group id: first level after "spBv1.0/" in every topic.
 * Keep it short - it is sent in every single topic string. */
#ifndef SPARKPLUG_GROUP_ID
#define SPARKPLUG_GROUP_ID "UCL"
#endif

/* How often the sensor is read (kravspec Projekt A: 5-15 s). */
#define APP_SAMPLE_INTERVAL_S   10

/* How often the node connects and sends everything it has collected
 * (option A: connect -> NBIRTH -> NDATA... -> NDEATH -> disconnect).
 * 3600 = hourly. Use something like 60 while developing. */
#ifndef APP_PUBLISH_INTERVAL_S
#define APP_PUBLISH_INTERVAL_S  3600
#endif

/* After a failed session (no network, broker down) try again this soon. */
#define APP_RETRY_INTERVAL_S    300

/* Max samples per NDATA message. One hour at 10 s = 360 samples, which is
 * sent as 6 messages of ~1 kB. Must match max_count in
 * proto/sparkplug_b.options. */
#define APP_NDATA_MAX_SAMPLES   60

/* Samples kept in RAM (16 B each). Two publish intervals, so one failed
 * session loses nothing. When full, the oldest sample is dropped. */
#define APP_SAMPLE_QUEUE_LEN    (2 * APP_PUBLISH_INTERVAL_S / APP_SAMPLE_INTERVAL_S)

/* SNTP: real UTC time for Sparkplug timestamps. Re-synced before a session
 * when the last sync is older than this, to correct clock drift. */
#define APP_SNTP_SERVER         "pool.ntp.org"
#define APP_SNTP_RESYNC_S       (24 * 3600)
```

## src/client_id.c
```c
#include "client_id.h"

#include <zephyr/kernel.h>
#include <zephyr/net/net_if.h>
#include <string.h>

static char client_id[32];

void build_client_id_initialize(void)
{
    struct net_if *iface = net_if_get_default();
    const struct net_linkaddr *lladdr;
    const uint8_t *mac;

    if (!iface) {
        snprintk(client_id, sizeof(client_id), "device-unknown");
        return;
    }

    lladdr = net_if_get_link_addr(iface);
    if (!lladdr || lladdr->len < 6) {
        snprintk(client_id, sizeof(client_id), "device-unknown");
        return;
    }

    mac = lladdr->addr;

    snprintk(client_id, sizeof(client_id),
             "device-%02x%02x%02x%02x%02x%02x",
             mac[0], mac[1], mac[2], mac[3], mac[4], mac[5]);
}

const char *build_client_id_get(void)
{
    return client_id;
}
```

## src/client_id.h
```c
#pragma once

void build_client_id_initialize(void);
const char *build_client_id_get(void);
```

## src/mqtt_client.c
```c
/* mqtt_client.c - MQTT transport for the Sparkplug B edge node.
 *
 * Session life cycle (one loop iteration of mqtt_thread_fn):
 *   1. sparkplug_begin_session()   -> new bdSeq
 *   2. CONNECT with NDEATH as Will  (QoS 1, not retained, clean session)
 *   3. CONNACK -> subscribe NCMD, then publish NBIRTH (seq 0)
 *   4. publish queued samples as NDATA (seq 1, 2, ...)
 *   5. on any error: abort, wait (backoff), go to 1
 *
 * All MQTT calls and all sparkplug_* calls happen in this one thread, so no
 * locking is needed. Other threads only touch the sample queue.
 */
#include "mqtt_client.h"
#include "mqtt_settings.h"
#include "client_id.h"
#include "time_sync.h"
#include "app_config.h"

#include <zephyr/kernel.h>
#include <zephyr/logging/log.h>
#include <zephyr/net/mqtt.h>
#include <zephyr/net/socket.h>
#include <string.h>
#include <errno.h>

LOG_MODULE_REGISTER(mqtt_client, LOG_LEVEL_INF);

#define RX_BUF_SIZE  512
#define TX_BUF_SIZE  512
#define STACK_SIZE   4096
#define KEEPALIVE_S  60U
#define BACKOFF_MIN_S 5
#define BACKOFF_MAX_S 60
#define CONNACK_TIMEOUT_MS 10000

BUILD_ASSERT(APP_SAMPLE_QUEUE_LEN >= APP_PUBLISH_BATCH_SIZE,
	     "sample queue must hold at least one batch");

static struct mqtt_client client;
static struct sockaddr_storage broker;
static uint8_t rx_buffer[RX_BUF_SIZE];
static uint8_t tx_buffer[TX_BUF_SIZE];
static struct zsock_pollfd fds;

static K_THREAD_STACK_DEFINE(mqtt_stack, STACK_SIZE);
static struct k_thread mqtt_thread_data;

K_MSGQ_DEFINE(sample_q, sizeof(struct sparkplug_sample), APP_SAMPLE_QUEUE_LEN, 8);
/* Counts samples dropped because the queue was full. The oldest samples are
 * the ones being published, so a drop during a publish means fewer items
 * are left to remove afterwards. */
static atomic_t samples_dropped;

/* Sparkplug topics, built once we know our node id */
static char topic_nbirth[SPARKPLUG_TOPIC_LEN];
static char topic_ndeath[SPARKPLUG_TOPIC_LEN];
static char topic_ndata[SPARKPLUG_TOPIC_LEN];
static char topic_ncmd[SPARKPLUG_TOPIC_LEN];

/* Payload buffers. The Will must stay valid for the whole session. */
static uint8_t will_buf[64];
static uint8_t payload_buf[SPARKPLUG_PAYLOAD_LEN];

static struct mqtt_topic will_topic;
static struct mqtt_utf8 will_msg;

/* Set from the event handler, acted on in the thread loop */
static atomic_t connected;
static bool birth_pending;

/* Last sample sent, so a rebirth can report the current value */
static struct sparkplug_sample last_sample;
static bool have_last_sample;

static int connect_mqtt(void);
static void mqtt_evt_handler(struct mqtt_client *const c, const struct mqtt_evt *evt);
static void mqtt_thread_fn(void *p1, void *p2, void *p3);

static struct mqtt_utf8 user = {
    .utf8 = (uint8_t *)MQTT_ESP32_USER,
    .size = sizeof(MQTT_ESP32_USER) - 1,
};
static struct mqtt_utf8 pass = {
    .utf8 = (uint8_t *)MQTT_ESP32_PASS,
    .size = sizeof(MQTT_ESP32_PASS) - 1,
};

int mqtt_client_initialize(void)
{
	k_thread_create(&mqtt_thread_data, mqtt_stack,
			K_THREAD_STACK_SIZEOF(mqtt_stack),
			mqtt_thread_fn,
			NULL, NULL, NULL,
			5, 0, K_NO_WAIT);

	k_thread_name_set(&mqtt_thread_data, "mqtt_client");
	return 0;
}

bool mqtt_client_is_connected(void)
{
	return atomic_get(&connected) != 0;
}

int mqtt_client_queue_sample(const struct sparkplug_sample *sample)
{
	struct sparkplug_sample dropped;

	while (k_msgq_put(&sample_q, sample, K_NO_WAIT) != 0) {
		/* full: drop the oldest and try again */
		if (k_msgq_get(&sample_q, &dropped, K_NO_WAIT) == 0) {
			atomic_inc(&samples_dropped);
			LOG_WRN("Sample queue full, dropped oldest sample");
		}
	}
	return 0;
}

/* Sparkplug: everything except the NDEATH Will is QoS 0, not retained */
static int publish(const char *topic, const uint8_t *data, size_t len)
{
	struct mqtt_publish_param param = {0};

	param.message.topic.qos = MQTT_QOS_0_AT_MOST_ONCE;
	param.message.topic.topic.utf8 = (const uint8_t *)topic;
	param.message.topic.topic.size = strlen(topic);
	param.message.payload.data = (uint8_t *)data;
	param.message.payload.len = len;

	return mqtt_publish(&client, &param);
}

static int publish_nbirth(void)
{
	int len = sparkplug_encode_nbirth(payload_buf, sizeof(payload_buf),
					  time_now_ms(),
					  have_last_sample ? &last_sample : NULL);
	if (len < 0) {
		return len;
	}

	int ret = publish(topic_nbirth, payload_buf, len);

	if (ret == 0) {
		LOG_INF("NBIRTH sent (%d bytes)", len);
	}
	return ret;
}

/* Sends one NDATA with up to APP_PUBLISH_BATCH_SIZE queued samples.
 * Samples are only removed from the queue once mqtt_publish() succeeded. */
static int publish_ndata_batch(void)
{
	struct sparkplug_sample batch[APP_PUBLISH_BATCH_SIZE];
	size_t n = 0;
	atomic_val_t dropped_before = atomic_get(&samples_dropped);

	while (n < APP_PUBLISH_BATCH_SIZE &&
	       k_msgq_peek_at(&sample_q, &batch[n], n) == 0) {
		n++;
	}
	if (n == 0) {
		return 0;
	}

	int len = sparkplug_encode_ndata(payload_buf, sizeof(payload_buf),
					 time_now_ms(), batch, n);
	if (len < 0) {
		return len;
	}

	int ret = publish(topic_ndata, payload_buf, len);

	if (ret) {
		return ret;
	}

	size_t dropped_meanwhile = atomic_get(&samples_dropped) - dropped_before;
	struct sparkplug_sample discard;

	for (size_t i = dropped_meanwhile; i < n; i++) {
		k_msgq_get(&sample_q, &discard, K_NO_WAIT);
	}
	last_sample = batch[n - 1];
	have_last_sample = true;
	LOG_INF("NDATA sent: %u sample(s), %d bytes", (unsigned int)n, len);
	return 0;
}

static int subscribe_ncmd(void)
{
	struct mqtt_topic t = {
		.topic = {
			.utf8 = (const uint8_t *)topic_ncmd,
			.size = strlen(topic_ncmd),
		},
		.qos = MQTT_QOS_0_AT_MOST_ONCE,
	};
	const struct mqtt_subscription_list list = {
		.list = &t,
		.list_count = 1,
		.message_id = 1,
	};

	return mqtt_subscribe(&client, &list);
}

/* Reads an incoming PUBLISH (only NCMD is subscribed) and checks for rebirth. */
static void handle_incoming_publish(struct mqtt_client *c, const struct mqtt_evt *evt)
{
	size_t len = evt->param.publish.message.payload.len;

	if (len > sizeof(payload_buf)) {
		/* Too big for us: read it away in chunks so the stream stays in sync */
		LOG_WRN("NCMD too large (%u bytes), ignored", (unsigned int)len);
		while (len > 0) {
			size_t chunk = MIN(len, sizeof(payload_buf));

			if (mqtt_readall_publish_payload(c, payload_buf, chunk) < 0) {
				return;
			}
			len -= chunk;
		}
		return;
	}

	if (mqtt_readall_publish_payload(c, payload_buf, len) < 0) {
		LOG_ERR("Failed to read NCMD payload");
		return;
	}

	if (sparkplug_ncmd_is_rebirth(payload_buf, len)) {
		LOG_INF("Rebirth requested by host");
		birth_pending = true;
	}
}

#ifdef MQTT_DEBUG_RAW_TCP_TEST
/* Plain TCP connect test. Off by default: it opens an extra connection on
 * every reconnect, which costs data on cellular. Define it in
 * mqtt_settings.h to turn it back on while debugging. */
static int test_raw_tcp_socket(void)
{
    int ret;
    int sock;
    struct sockaddr_in addr = {0};

    sock = zsock_socket(AF_INET, SOCK_STREAM, IPPROTO_TCP);
    if (sock < 0) {
        printk("socket failed: %d\n", sock);
        return sock;
    }

    addr.sin_family = AF_INET;
    addr.sin_port = htons(MQTT_BROKER_PORT);

    ret = zsock_inet_pton(AF_INET, MQTT_BROKER_HOSTNAME, &addr.sin_addr);
    if (ret <= 0) {
        printk("inet_pton failed: %d\n", ret);
        zsock_close(sock);
        return -EINVAL;
    }

    ret = zsock_connect(sock, (struct sockaddr *)&addr, sizeof(addr));
    printk("raw connect ret = %d\n", ret);

    zsock_close(sock);
    return ret;
}
#endif

static int connect_mqtt(void)
{
	int ret;
	struct sockaddr_in *broker4 = (struct sockaddr_in *)&broker;
	const char *id = build_client_id_get();

	broker4->sin_family = AF_INET;
	broker4->sin_port = htons(MQTT_BROKER_PORT);

	if (zsock_inet_pton(AF_INET, MQTT_BROKER_HOSTNAME, &broker4->sin_addr) != 1) {
		LOG_ERR("Invalid broker IP");
		return -EINVAL;
	}

#ifdef MQTT_DEBUG_RAW_TCP_TEST
	ret = test_raw_tcp_socket();
	if (ret < 0) {
		return ret;
	}
#endif

	/* New session: new bdSeq, and a Will (NDEATH) carrying that bdSeq */
	sparkplug_begin_session();
	ret = sparkplug_encode_ndeath(will_buf, sizeof(will_buf));
	if (ret < 0) {
		return ret;
	}
	will_topic.topic.utf8 = (const uint8_t *)topic_ndeath;
	will_topic.topic.size = strlen(topic_ndeath);
	will_topic.qos = MQTT_QOS_1_AT_LEAST_ONCE; /* Sparkplug requires QoS 1 */
	will_msg.utf8 = will_buf;
	will_msg.size = ret;

	mqtt_client_init(&client);
	client.user_name = &user;
	client.password  = &pass;
	client.broker = &broker;
	client.evt_cb = mqtt_evt_handler;
	client.client_id.utf8 = (uint8_t *)id;
	client.client_id.size = strlen(id);
	client.protocol_version = MQTT_VERSION_3_1_1;
	client.rx_buf = rx_buffer;
	client.rx_buf_size = sizeof(rx_buffer);
	client.tx_buf = tx_buffer;
	client.tx_buf_size = sizeof(tx_buffer);
	client.keepalive = KEEPALIVE_S;
	client.clean_session = 1;          /* Sparkplug requires clean session */
	client.will_topic = &will_topic;
	client.will_message = &will_msg;
	client.will_retain = 0;            /* Sparkplug: NDEATH is never retained */
	client.transport.type = MQTT_TRANSPORT_NON_SECURE; /* TODO: TLS */

	return mqtt_connect(&client);
}

static void mqtt_evt_handler(struct mqtt_client *const c, const struct mqtt_evt *evt)
{
	switch (evt->type) {
	case MQTT_EVT_CONNACK:
		if (evt->result != 0) {
			LOG_ERR("CONNACK refused, code %d", evt->result);
			break;
		}
		LOG_INF("MQTT connected");
		atomic_set(&connected, 1);
		/* Don't publish from inside the callback: let the loop do it */
		birth_pending = true;
		break;

	case MQTT_EVT_SUBACK:
		LOG_INF("Subscribed to %s", topic_ncmd);
		break;

	case MQTT_EVT_PUBLISH:
		handle_incoming_publish(c, evt);
		break;

	case MQTT_EVT_DISCONNECT:
		LOG_INF("MQTT disconnected: %d", evt->result);
		atomic_set(&connected, 0);
		break;

	default:
		break;
	}
}

/* Runs one connected session until something fails. Returns the error. */
static int run_session(void)
{
	int rc;

	int64_t connect_started = k_uptime_get();

	fds.fd = client.transport.tcp.sock;
	fds.events = ZSOCK_POLLIN;

	while (1) {
		if (!mqtt_client_is_connected() &&
		    k_uptime_get() - connect_started > CONNACK_TIMEOUT_MS) {
			LOG_ERR("No CONNACK from broker");
			return -ETIMEDOUT;
		}

		if (mqtt_client_is_connected()) {
			if (birth_pending) {
				/* NCMD first, so a rebirth request can't be missed */
				rc = subscribe_ncmd();
				if (rc == 0) {
					rc = publish_nbirth();
				}
				if (rc) {
					LOG_ERR("NBIRTH failed: %d", rc);
					return rc;
				}
				birth_pending = false;
			}

			if (k_msgq_num_used_get(&sample_q) >= APP_PUBLISH_BATCH_SIZE) {
				rc = publish_ndata_batch();
				if (rc) {
					LOG_ERR("NDATA failed: %d", rc);
					return rc;
				}
			}
		}

		rc = zsock_poll(&fds, 1, 1000);
		if (rc < 0) {
			LOG_ERR("poll failed: %d", errno);
			return -errno;
		}

		if (fds.revents & (ZSOCK_POLLERR | ZSOCK_POLLHUP | ZSOCK_POLLNVAL)) {
			LOG_ERR("socket error: revents=0x%x", fds.revents);
			return -ECONNRESET;
		}

		if (fds.revents & ZSOCK_POLLIN) {
			rc = mqtt_input(&client);
			if (rc < 0) {
				LOG_ERR("mqtt_input failed: %d", rc);
				return rc;
			}
		}

		rc = mqtt_live(&client);
		if (rc < 0 && rc != -EAGAIN) {
			LOG_ERR("mqtt_live failed: %d", rc);
			return rc;
		}
	}
}

static void mqtt_thread_fn(void *p1, void *p2, void *p3)
{
	ARG_UNUSED(p1);
	ARG_UNUSED(p2);
	ARG_UNUSED(p3);

	const char *node_id = build_client_id_get();
	int backoff_s = BACKOFF_MIN_S;

	sparkplug_build_topic(SP_MSG_NBIRTH, node_id, topic_nbirth, sizeof(topic_nbirth));
	sparkplug_build_topic(SP_MSG_NDEATH, node_id, topic_ndeath, sizeof(topic_ndeath));
	sparkplug_build_topic(SP_MSG_NDATA,  node_id, topic_ndata,  sizeof(topic_ndata));
	sparkplug_build_topic(SP_MSG_NCMD,   node_id, topic_ncmd,   sizeof(topic_ncmd));
	LOG_INF("Sparkplug node topics: %s", topic_ndata);

	/* Reconnect forever: Project B-style robustness also helps Project A */
	while (1) {
		atomic_set(&connected, 0);
		birth_pending = false;

		int rc = connect_mqtt();

		if (rc == 0) {
			rc = run_session();
			if (mqtt_client_is_connected()) {
				/* we got as far as CONNACK, so start over with short wait */
				backoff_s = BACKOFF_MIN_S;
			}
			mqtt_abort(&client);
		} else {
			LOG_ERR("mqtt_connect failed: %d", rc);
		}

		atomic_set(&connected, 0);
		LOG_INF("Reconnecting in %d s", backoff_s);
		k_sleep(K_SECONDS(backoff_s));
		backoff_s = MIN(backoff_s * 2, BACKOFF_MAX_S);
	}
}
```

## src/mqtt_client.h
```c
/* mqtt_client.h */
#pragma once

#include "sparkplug.h"

/* Starts the MQTT thread. Every APP_PUBLISH_INTERVAL_S it connects, sends
 * NBIRTH + all queued samples as NDATA + NDEATH, and disconnects again. */
int mqtt_client_initialize(void);

/* Hands a sample to the MQTT thread. Safe to call from any thread.
 * If the queue is full (broker unreachable for a long time) the oldest
 * sample is dropped to make room. */
int mqtt_client_queue_sample(const struct sparkplug_sample *sample);
```

## src/mqtt_payload.c
```c
// mqtt_payload.c
#include "mqtt_payload.h"
#include "client_id.h"

#include <zephyr/kernel.h>
#include <stdio.h>

static char hello_msg[64];
static char plc_msg[128];

const char *mqtt_build_hello_world_message(void)
{
    snprintk(hello_msg, sizeof(hello_msg),
             "hello world from %s", build_client_id_get());
    return hello_msg;
}

const char *mqtt_build_plc_payload_message(void)
{
    snprintk(plc_msg, sizeof(plc_msg),
             "{\"client_id\":\"%s\",\"type\":\"PLC\"}", build_client_id_get());
    return plc_msg;
}
```

## src/mqtt_payload.h
```c
// mqtt_payload.h
#pragma once

const char *mqtt_build_hello_world_message(void);
const char *mqtt_build_plc_payload_message(void);
```

## src/network.c
```c
#include "network.h"
#include "wifi_creds.h"

#include <string.h>
#include <zephyr/kernel.h>
#include <zephyr/logging/log.h>
#include <zephyr/net/net_if.h>
#include <zephyr/net/net_mgmt.h>
#include <zephyr/net/net_event.h>
#include <zephyr/net/wifi_mgmt.h>

LOG_MODULE_REGISTER(network, LOG_LEVEL_INF);

static struct net_mgmt_event_callback wifi_cb;
static struct net_mgmt_event_callback ipv4_cb;
static struct k_sem wifi_connected_sem;
static struct k_sem ipv4_ready_sem;

static void wifi_event_handler(struct net_mgmt_event_callback *cb,
			       uint64_t mgmt_event,
			       struct net_if *iface)
{
	const struct wifi_status *status = (const struct wifi_status *)cb->info;

	if (mgmt_event == NET_EVENT_WIFI_CONNECT_RESULT) {
		if (status && status->status) {
			LOG_ERR("Wi-Fi connect failed: %d", status->status);
		} else {
			LOG_INF("Wi-Fi connected");
			k_sem_give(&wifi_connected_sem);
		}
	} else if (mgmt_event == NET_EVENT_WIFI_DISCONNECT_RESULT) {
		LOG_INF("Wi-Fi disconnected");
	}
}

static void ipv4_event_handler(struct net_mgmt_event_callback *cb,
			       uint64_t mgmt_event,
			       struct net_if *iface)
{
	if (mgmt_event == NET_EVENT_IPV4_ADDR_ADD) {
		LOG_INF("IPv4 address acquired");
		k_sem_give(&ipv4_ready_sem);
	}
}

int network_init(void)
{
	struct net_if *iface = net_if_get_default();
	struct wifi_connect_req_params params = { 0 };
	int ret;

	k_sem_init(&wifi_connected_sem, 0, 1);
	k_sem_init(&ipv4_ready_sem, 0, 1);

	net_mgmt_init_event_callback(&wifi_cb, wifi_event_handler,
				     NET_EVENT_WIFI_CONNECT_RESULT |
				     NET_EVENT_WIFI_DISCONNECT_RESULT);
	net_mgmt_add_event_callback(&wifi_cb);

	net_mgmt_init_event_callback(&ipv4_cb, ipv4_event_handler,
				     NET_EVENT_IPV4_ADDR_ADD);
	net_mgmt_add_event_callback(&ipv4_cb);

	net_if_up(iface);

	params.ssid = WIFI_SSID;
	params.ssid_length = strlen(WIFI_SSID);
	params.psk = WIFI_PASSWORD;
	params.psk_length = strlen(WIFI_PASSWORD);
	params.channel = WIFI_CHANNEL_ANY;
	params.band = WIFI_FREQ_BAND_2_4_GHZ;
	params.security = WIFI_SECURITY_TYPE_PSK;
	params.mfp = WIFI_MFP_OPTIONAL;

	LOG_INF("Connecting to Wi-Fi SSID: %s", params.ssid);

	ret = net_mgmt(NET_REQUEST_WIFI_CONNECT, iface, &params, sizeof(params));
	if (ret) {
		LOG_ERR("net_mgmt connect request failed: %d", ret);
		return ret;
	}

	ret = k_sem_take(&wifi_connected_sem, K_SECONDS(10));
	if (ret) {
		LOG_ERR("Wi-Fi connect timeout");
		return ret;
	}

	ret = k_sem_take(&ipv4_ready_sem, K_SECONDS(20));
	if (ret) {
		LOG_ERR("DHCP timeout");
		return ret;
	}

	LOG_INF("Network is up");
	return 0;
}
```

## src/network.h
```c
// pragma once ensures that the header file is only included once
#pragma once

int network_init(void);
```

## src/sparkplug.h
```c
/* sparkplug.h - Sparkplug B (spBv1.0) topics and payload encoding.
 *
 * This module knows nothing about sockets or MQTT; it only builds topic
 * strings and turns data into protobuf bytes (via nanopb), and back.
 *
 * Not thread safe: call it from the MQTT thread only.
 */
#pragma once

#include <stdbool.h>
#include <stddef.h>
#include <stdint.h>

#include "app_config.h"

#define SPARKPLUG_NAMESPACE   "spBv1.0"
#define SPARKPLUG_TOPIC_LEN   96
#define SPARKPLUG_PAYLOAD_LEN 1280 /* fits APP_NDATA_MAX_SAMPLES = 60 */

/* Metric names as sent in NBIRTH. */
#define SP_METRIC_BDSEQ       "bdSeq"
#define SP_METRIC_REBIRTH     "Node Control/Rebirth"
#define SP_METRIC_TEMPERATURE "Temperature"

/* Aliases: sent together with the name in NBIRTH, and alone in NDATA.
 * bdSeq has no alias, because it is only ever sent in NBIRTH/NDEATH. */
enum sparkplug_alias {
	SP_ALIAS_REBIRTH     = 1,
	SP_ALIAS_TEMPERATURE = 2,
};

enum sparkplug_msg_type {
	SP_MSG_NBIRTH,
	SP_MSG_NDEATH,
	SP_MSG_NDATA,
	SP_MSG_NCMD,
};

/* One sensor reading. timestamp_ms is ms since Unix epoch (UTC) when it is
 * encoded; while queued on the device it holds k_uptime_get() instead. */
struct sparkplug_sample {
	uint64_t timestamp_ms;
	float temperature_c;
};

/* Builds "spBv1.0/<group>/<type>/<node_id>". Returns 0 or -ENOMEM. */
int sparkplug_build_topic(enum sparkplug_msg_type type, const char *node_id,
			  char *buf, size_t len);

/* Starts a new MQTT session: bumps bdSeq (0 on the very first session).
 * Call once before every mqtt_connect(), then encode the NDEATH Will. */
void sparkplug_begin_session(void);

/* The encoders return the number of bytes written, or a negative errno. */

/* NDEATH: registered as MQTT Will at connect. Contains only bdSeq. */
int sparkplug_encode_ndeath(uint8_t *buf, size_t len);

/* NBIRTH: every metric with name, alias, datatype and current value.
 * Resets seq to 0. `latest` may be NULL if nothing has been sampled yet. */
int sparkplug_encode_nbirth(uint8_t *buf, size_t len, uint64_t now_ms,
			    const struct sparkplug_sample *latest);

/* NDATA: `count` samples by alias only. All but the newest sample are
 * flagged is_historical, so a host knows they are buffered, older values. */
int sparkplug_encode_ndata(uint8_t *buf, size_t len, uint64_t now_ms,
			   const struct sparkplug_sample *samples, size_t count);

/* True if an NCMD payload asks for a rebirth (by name or alias).
 * Not used with option A (the node doesn't subscribe to NCMD), kept for
 * when the node stays connected or commands are added. */
bool sparkplug_ncmd_is_rebirth(const uint8_t *buf, size_t len);
```
